## tools/fit_img.its
```
/dts-v1/;

/ {
	description = "U-boot-spl FIT image for JH7110 VisionFive2";
	#address-cells = <2>;

	images {
		firmware {
			description = "u-boot";
			data = /incbin/("firmware_abs_path");
			type = "firmware";
			arch = "riscv";
			os = "u-boot";
			load = <0x0 0xC0000000>;
			entry = <0x0 0xC0000000>;
			compression = "none";
		};
	};

	configurations {
		default = "config-1";

		config-1 {
			description = "U-boot-spl FIT config for JH7110 VisionFive2";
			firmware = "firmware";
		};
	};
};
```
